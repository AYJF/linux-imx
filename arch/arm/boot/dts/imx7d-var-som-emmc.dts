// SPDX-License-Identifier: GPL-2.0+ OR MIT
//
// Copyright (C) 2016-2022 Variscite Ltd.

/dts-v1/;

#include "imx7d-var-som.dtsi"
#include "imx7d-var-som-emmc.dtsi"
#include "imx7d-var-som-mx7customboard.dtsi"

/ {
	model = "QEI Inc. MicroPAQ 940P 06/22/2024";
	compatible = "fsl,imx7d-var-som", "fsl,imx7d";
};

